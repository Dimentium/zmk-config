#define KEY_L 1
#define KEY_G 2
#define KEY_D 3

#define KEY_H 6
#define KEY_U 7
#define KEY_O 8

#define KEY_I 10
#define KEY_R 11
#define KEY_S 12
#define KEY_T 13

#define KEY_N 16
#define KEY_E 17
#define KEY_A 18
#define KEY_C 19

#define THUMB_LL 30
#define THUMB_LR 31
#define THUMB_RL 32
#define THUMB_RR 33

#define LEFT_HALF   0  1  2  3  4 10 11 12 13 14 20 21 22 23 24 
#define RIGHT_HALF  5  6  7  8  9 15 16 17 18 19 25 26 27 28 29
#define THUMBS     30 31 32 33
#define _____  &none

// Include main keymap
#include "../../../../dk_keymap.dtsi"