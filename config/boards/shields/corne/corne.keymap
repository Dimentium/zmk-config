#define THUMBS     36 37 38 39 40 41
#define MIDDLE_ALPHA &mo QWE   &mo QWE
#define MIDDLE_TRANS &trans    &trans
#define MIDDLE_QWE   &kp SQT   &kp SQT
#define MIDDLE_MOUSE &mkp MB3  &mkp MB3
#define MIDDLE_LALT  &kp LALT  &kp LALT

#define MIDDLE(NAME) &kp NAME  &kp NAME

// Include main keymap
#include "../../../../keymap_30.dtsi"
