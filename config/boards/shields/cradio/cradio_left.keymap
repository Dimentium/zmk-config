/*
* Copyright (c) 2020 The ZMK Contributors
*
* SPDX-License-Identifier: MIT
*/

#include <behaviors.dtsi>
#include <dt-bindings/zmk/keys.h>
#include <dt-bindings/zmk/bt.h>

// Layers
#define DK_CRADIO_LEFT 1

// ARTS Row
#define KEY_A 3
#define KEY_R 2
#define KEY_T 1
#define KEY_S 0
// EYIO Row
#define KEY_E 8
#define KEY_Y 7
#define KEY_I 6
#define KEY_O 5

// Define Offsets
#define LEADING_NONES NONE(0,0,0)
#define MIDDLE_NONES NONE(0,0,1)
#define TRAILING_NONES NONE(0,0,8)

#define LEFT_HALF 0 1 2 3 4 10 11 12 13 14 20 21 22 23 24 
#define RIGHT_HALF 5 6 7 8 9 15 16 17 18 19 25 26 27 28 29
#define THUMBS    30 31 32 33

// Include main keymap
#include "../../../dk_keymap.dtsi"