## config/boards/shields/aniote/Kconfig.defconfig
```kconfig
if SHIELD_ANIOTE

config ZMK_KEYBOARD_NAME
    default "Aniote"

config ZMK_USB
    default n

config ZMK_BEHAVIOR_METADATA
    default y

endif
```

## config/boards/shields/cradio/Kconfig.defconfig
```kconfig
# Copyright (c) 2020 The ZMK Contributors
# SPDX-License-Identifier: MIT

if SHIELD_CRADIO_LEFT

config ZMK_KEYBOARD_NAME
    default "Cradio"

config ZMK_SPLIT_ROLE_CENTRAL
    default y

endif

if SHIELD_CRADIO_RIGHT

config ZMK_KEYBOARD_NAME
    default "Cradio Right"

config ZMK_USB
    default n

endif

if SHIELD_CRADIO_LEFT || SHIELD_CRADIO_RIGHT

config ZMK_SPLIT
    default y

config ZMK_BEHAVIOR_METADATA
    default y

endif
```

## config/boards/shields/cradio/Kconfig.shield
```kconfig
# Copyright (c) 2021 Mike "KemoNine" Crosson
# SPDX-License-Identifier: MIT

config SHIELD_CRADIO_LEFT
	def_bool $(shields_list_contains,cradio_left)

config SHIELD_CRADIO_RIGHT
	def_bool $(shields_list_contains,cradio_right)
```

## config/west.yml
```yaml
manifest:
  remotes:
    - name: petejohanson
      url-base: https://github.com/petejohanson
    - name: zmkfirmware
      url-base: https://github.com/zmkfirmware
  projects:
    - name: zmk
      remote: zmkfirmware
      revision: main
      # remote: petejohanson
      # revision: feat/pointers-move-scroll
      import: app/west.yml
  self:
    path: config
```
