#define KEY_L 0
#define KEY_G 1
#define KEY_D 2

#define KEY_H 3
#define KEY_U 4
#define KEY_O 5

#define KEY_I 6
#define KEY_R 7
#define KEY_S 8
#define KEY_T 9

#define KEY_N 10
#define KEY_E 11
#define KEY_A 12
#define KEY_C 13

#define THUMB_LL 14
#define THUMB_LR 15
#define THUMB_RL 16
#define THUMB_RR 17

#define LEFT_HALF   0  1  2  6  7  8  9
#define RIGHT_HALF  3  4  5 10 11 12 13
#define THUMBS     14 15 16 17
#define _____ 

// Include main keymap
#include "../../../../dk_keymap.dtsi"